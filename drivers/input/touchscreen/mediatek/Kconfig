## drivers/input/touchscreen/mediatek/Kconfig
```kconfig
#
# Touchscreen driver configuration
#
menuconfig INPUT_TOUCHSCREEN
	bool "Touchscreens"
	help
	  Say Y here, and a list of supported touchscreens will be displayed.
	  This option doesn't affect the kernel.

	  If unsure, say Y.

if INPUT_TOUCHSCREEN

config TOUCHSCREEN_MTK
	bool "MediaTek Touch Panel Driver"
	help
	  Say Y here if you have MediaTek touch panel.

	  If unsure, say N.

	  To compile this dirver as a module, choose M here: the
	  module will be called.

config TOUCHSCREEN_PHYSICAL_ROTATION_WITH_LCM
	bool "MediaTek Touch Panel Rotation With LCM"
	default y
	help
	  Say N here if touch panel is not physical rotated as LCM does.
	  Physically rotated means that this driver will map
	  the reported coordination to diagonal position.

	  If unsure, say Y.
config TOUCHSCREEN_MTK_SOLOMON
	bool "SOLOMON for Mediatek package"
	default n
	help
	  Say Y here if you have SOLOMON touch panel.

	  If unsure, say N.

	  To compile this dirver as a module, choose M here: the
	  module will be called.

source "drivers/input/touchscreen/mediatek/SOLOMON/Kconfig"

#ifdef ODM_HQ_EDIT
#zhangyin@ODM_HQ.BSP.TP  2018/11/29 add for TP drivers
#config TOUCHSCREEN_MTK_FOCALTECH_TS
#	bool "FOCALTECH_TS for Mediatek package"
#	default n
#	help
#	  Say Y here if you have focaltech_touch touch panel.
#
#	  If unsure, say N.
#
#	  To compile this dirver as a module, choose M here: the
#	  module will be called.

#source "drivers/input/touchscreen/mediatek/focaltech_touch/Kconfig"

config TOUCHSCREEN_MTK_FOCALTECH_TS
        bool "FT5446 for Mediatek package"
        default n
        help
          Say Y here if you have focaltech_touch touch panel.

          If unsure, say N.

          To compile this dirver as a module, choose M here: the
          module will be called.

source "drivers/input/touchscreen/mediatek/ft5446/Kconfig"

config TOUCHSCREEN_HIMAX_CHIPSET
    bool "Himax touchpanel CHIPSET"
    depends on I2C
    help
      Say Y here if you have a Himax CHIPSET touchscreen.
      HIMAX controllers are multi touch controllers which can
      report 10 touches at a time.

      If unsure, say N.
source "drivers/input/touchscreen/mediatek/hx8527/Kconfig"

#Wenchao.Du@ODM_HQ.BSP.TP  2019/01/17 add for TP drivers
config TOUCHSCREEN_MTK_GT9XX
	bool "GOODDIX_UPDATE_GT9XX for Mediatek package"
	default n
	help
	  Say Y here if you have GT9XX touch panel.

	  If unsure, say N.

	  To compile this dirver as a module, choose M here: the
	  module will be called.

source "drivers/input/touchscreen/mediatek/gt9xx_mtk/Kconfig"

#endif #ODM_HQ_EDIT

config TOUCHSCREEN_MTK_GT1151
	bool "GT1151 for Mediatek package"
	default n
	help
	  Say Y here if you have GT1151 touch panel.

	  If unsure, say N.

	  To compile this dirver as a module, choose M here: the
	  module will be called.

source "drivers/input/touchscreen/mediatek/GT1151/Kconfig"

config TOUCHSCREEN_MTK_NT36xxx
	bool "NT36xxx for Mediatek package"
	default n
	help
	  Say Y here if you have NT36xxx touch panel.

	  If unsure, say N.

	  To compile this dirver as a module, choose M here: the
	  module will be called.

source "drivers/input/touchscreen/mediatek/NT36xxx/Kconfig"

endif
```

## drivers/misc/hqdevinfo/Kconfig
```kconfig
config HQ_DEVINFO_SUPPORT
  bool "Enable Huaqin Devinfo Driver"
  default n
  help
    Huaqin devices information driver includes specific information about hardware info and other info for HQ tools
```

## drivers/misc/mediatek/mmp/Kconfig
```kconfig
config MTK_MMPROFILE_SUPPORT
	bool "MMProfile function enable or disable"
	#ifndef VENDOR_EDIT
	#GaoTing.Gan@PSW.MultiMedia.MediaServer, 2019/02/27, Modify for close MMPOFILE_SUPPORT to add memory
	#default y
	#else /* VENDOR_EDIT */
	default n
	#endif /* VENDOR_EDIT */
	help
	  Multimedia profiling mechanism function support.
	  By enable this config, the actual implementation under mmp/src/
	  will be used.
	  Otherwise mmp/dummy/ is used to provide empty functions. In this
	  situation, the profiling mechanism will not work.

config MMPROFILE
	bool "MMProfile module enable or disable"
	default y
	help
	  Enable other module to use Multimedia profiling mechanism.
	  By enable this config, the mmp/ driver is built into kernel.
	  Otherwise other module will use empty functions in header file
	  instead. This is to make the profiling mechanism driver to be
	  a switchable module.
```

## drivers/power/Kconfig
```kconfig
source "drivers/power/avs/Kconfig"
source "drivers/power/reset/Kconfig"
source "drivers/power/supply/Kconfig"

#ifdef VENDOR_EDIT /* Jianchao.Shi@BSP.CHG.Basic, 2018/11/09, sjc Add for charging */
source "drivers/power/oppo/Kconfig"

config OPPO_CHARGER
	bool "OPPO_CHARGER"
	default n
	help
	  Set Yes to support OPPO_CHARGER features
	  smart battery.
	  Set No to disable OPPO_CHARGER features
	  smart battery.

config OPPO_CHARGER_MTK
	bool "OPPO charger on MTK"
	default n
	help
	  Say Yes here to declare charging system is on MTK
	  Say No here to declare charging system is not on MTK

config OPPO_CHARGER_MTK_CHGIC
	bool "OPPO_CHARGER_MTK_CHG_IC"
	default n
	help
	  Say Yes to use MTK platform charger ic
	  Say No to use extern charger ic

config OPPO_CHARGER_MTK6779
	bool "OPPO_CHARGER_MTK6779"
	default n
	help
	  Set yes to support OPPO_CHARGER_MTK6779 features
	  smart battery.
	  Set No to disable OPPO_CHARGER_MTK6779 features
	  smart battery.

config OPPO_CHECK_CHARGERID_VOLT
	bool "OPPO_CHECK_CHARGERID_VOLT"
	default n
	help
	  Set yes to support OPPO_CHECK_CHARGERID_VOLT features
	  smart battery.
	  Set No to disable OPPO_CHECK_CHARGERID_VOLT features
	  smart battery.

config OPPO_4400MV_BATTERY_SUPPORT
	bool "OPPO_CHECK_CHARGERID_VOLT"
	default n
	help
	  Set yes to support BATTERYID features
	  smart battery.
	  Set No to disable BATTERYID features
	  smart battery.

config OPPO_CALL_MODE_SUPPORT
	bool "OPPO call mode support"
	default n
	help
	  Say Y to enable support for the oppo call mode.

config OPPO_SHIP_MODE_SUPPORT
	bool "OPPO ship mode support"
	default n
	help
	  Say Y to include support

config OPPO_SHORT_HW_CHECK
	bool "OPPO batt HW SHORT"
	default n
	help
	  Say Y to include support
#endif /* VENDOR_EDIT */
```

## drivers/soc/oppo/oppo_criticallog/Kconfig
```kconfig
config OPPO_CRITICALLOG
	bool "config oppo critical log"
	help
		define this config to init oppo critical log driver.
```

## drivers/soc/oppo/oppo_custom/Kconfig
```kconfig
config OPPO_CUSTOM
	bool "config oppo custom"
	help
		define this config to compile oppo_custom.c for device register
```

## drivers/soc/oppo/oppo_hypnus/Kconfig
```kconfig
config HYPNUS_HELPER
	bool "config hypnus helper"
	help
		Provide helper functions for hypnus.
```
